## conf/layer.conf
```bitbake
# We have a conf and classes directory, add to BBPATH
BBPATH := "${BBPATH}:${LAYERDIR}"

# We have a recipes directory, add to BBFILES
BBFILES := "${BBFILES} ${LAYERDIR}/recipes-*/*/*.bb \
	${LAYERDIR}/recipes-*/*/*.bbappend"

BBFILE_COLLECTIONS += "lanner-nca1010"
BBFILE_PATTERN_lanner-nca1010 := "^${LAYERDIR}/"
BBFILE_PRIORITY_lanner-nca1010 = "6"
```

## conf/machine/lanner-nca1010.conf
```bitbake
#@TYPE: Machine
#@NAME: lanner-nca1010

#@DESCRIPTION: Machine configuration for Lanner NCA-1010

PREFERRED_PROVIDER_virtual/kernel ?= "linux-tplino"
PREFERRED_VERSION_linux-yocto ?= "3.8%"

require conf/machine/include/tune-atom.inc
DEFAULTTUNE = "core2-64"

KERNEL_IMAGETYPE = "bzImage"

MACHINE_ESSENTIAL_EXTRA_RDEPENDS_append = " udev-lanner-nca1010"
MACHINE_FEATURES += "pcbios"

FEEDNAMEPREFIX ??= "tplino-lanner-nca1010"
FEEDURIPREFIX ??= "lanner-nca1010"

SYSLINUX_ROOT = "root=/dev/sda1"
SYSLINUX_OPTS = "serial 0 115200"
SYSLINUX_LABELS ?= "install boot"
SERIAL_CONSOLE = "115200 ttyS0"
GRUB_OPTS ?= "serial --unit=0 --speed=115200 --word=8 --parity=no --stop=1"
APPEND += "console=tty0 console=ttyS0,115200 acpi_enforce_resources=lax debugshell"
```
